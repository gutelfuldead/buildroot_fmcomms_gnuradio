## packages/gr-iio/Config.in
```kconfig
config BR2_PACKAGE_GR_IIO
	bool "gr-iio"
	depends on BR2_PACKAGE_GNURADIO
	depends on BR2_PACKAGE_LIBIIO
	depends on BR2_PACKAGE_LIBAD9361_IIO
	depends on BR2_PACKAGE_GNURADIO_ANALOG
	select BR2_PACKAGE_GNURADIO_BLOCKS
	help
	  IIO blocks for GNU Radio
		
	  https://github.com/analogdevicesinc/gr-iio
```

## packages/librta/Config.in
```kconfig
config BR2_PACKAGE_LIBRTA
	bool "librta"
	help
		Run-Time Access Library, librta allows data structures in program as tables in a PostgreSQL database or as files in a virtual file system (similar to /proc)
```
